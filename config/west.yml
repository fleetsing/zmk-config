## config/west.yml
```yaml
manifest:
  defaults:
    revision: v0.3 # version to use for ZMK and modules
  remotes:
    - name: zmkfirmware
      url-base: https://github.com/zmkfirmware
    - name: urob
      url-base: https://github.com/urob
  projects:
    - name: zmk
      remote: zmkfirmware
      import: app/west.yml
    - name: zmk-adaptive-key
      remote: urob
    - name: zmk-tri-state
      remote: urob
    - name: zmk-auto-layer
      remote: urob
    - name: zmk-helpers
      remote: urob
  self:
    path: config
```
